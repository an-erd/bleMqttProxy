## main/Kconfig.projbuild
```kconfig
menu "BLE-MQTT Proxy"

    choice PROXY_DEVICE
        prompt "Device to be used"
        default DEVICE_M5STACK
        help
            Choose which device is used for the bleMqttProxy.
        config DEVICE_WEMOS
            bool "ESP32 WEMOS LOLIN board with OLED display (SSD1306)"
        config DEVICE_M5STACK
            bool "M5Stack Fire device with TFT display (ILI9341)"
    endchoice #PROXY_DEVICE

    menu "Wifi Configuration"

        config WIFI_SSID
            string "WiFi SSID"
            default "myssid"
            help
                SSID (network name) for the example to connect to.

        config WIFI_PASSWORD
            string "WiFi Password"
            default "mypassword"
            help
                WiFi password (WPA or WPA2) for the example to use.
    endmenu

    menu "Own Watchdog timer (WDT)"

        config WDT_OWN_INTERVAL
            int "Interval in sec for watchdog timer to check."
            default 10
            help
                Set the interval to use for the watchdog timer. Use 0 for no WDT at all.

        config WDT_LAST_SEEN_THRESHOLD
            int "Threshold value in seconds for last seen to determine 'not alive'"
            default 1800

        config WDT_REBOOT_LAST_SEEN_THRESHOLD
            int "Reboot if the last seen threshold applies."
            default 1

        config WDT_LAST_SEND_THRESHOLD
            int "Threshold value in seconds for last MQTT send to determine 'not alive'"
            default 1800

        config WDT_REBOOT_LAST_SEND_THRESHOLD
            int "Reboot if the last MQTT send threshold applies."
            default 1

        config WDT_SEND_MQTT_BEFORE_REBOOT
            int "Send (or at least try to send) a last MQTT message if last seen and/or last MQTT send threshold applies (just before reboot, if configured)"
            default 1

        config WDT_SEND_REGULAR_UPTIME_HEAP_MQTT
            int "Send a regular MQTT message with uptime and free heap information"
            default 0

        config WDT_MQTT_FORMAT
            string
            default "/%s/%s"
            help
                ip -> data

    endmenu

    menu "Display"

        config DISPLAY_IDLE_TIMER
            int "Display idle timer"
            default 60
            range 0 600
            help
                Number of seconds without button to show empty screen, 0 disables idle timer"

        config DISPLAY_MESSAGE_TIME
            int "Time in sec to show a message"
            default 5
            range 1 15
            help
                Number of seconds to show a message, shwitch to last shown screen afterwards.
    endmenu

    menu "MQTT Configuration"

        config USE_MQTT
            int "MQTT"
            default 1
            range 0 1

        config MQTT_MIN_TIME_INTERVAL_BETWEEN_MESSAGES
            int "Wait time between MQTT messages for same device (sec)"
            default 60
            range 0 3600
            help
                Only send a MQTT message to the same device only once during this time interval.

        config MQTT_HOST
            string "MQTT Broker Host"
            default "iot.eclipse.org"
            help
                MQTT Host to connect to

        config MQTT_BROKER_URL
            string "MQTT Broker URL"
            default "mqtt://iot.eclipse.org"
            help
                URL of the broker to connect to

        config MQTT_PORT
            int "MQTT port"
            default 1883
            help
                TCP port to connect to

        config MQTT_USERNAME
            string "MQTT username"
            help
                MQTT USERNAME

        config MQTT_PASSWORD
            string "MQTT password"
            help
                MQTT password
    endmenu

    config MQTT_FORMAT
        string
        default "/%s/0x%04x/x%04x/%s"
        help
            identifier, maj, min, sensor -> data
    menu "Range of values"
        config TEMP_LOW
            int "Temperature low range"
            default -45
        config TEMP_HIGH
            int "Temperature high range"
            default 120
        config HUMIDITY_LOW
            int "Humidity low range"
            default 0
        config HUMIDITY_HIGH
            int "Humidity high range"
            default 100
        config BATTERY_LOW
            int "Battery low range"
            default 0
        config BATTERY_HIGH
            int "Battery high range"
            default 3300
    endmenu

    menu "BLE Devices"
        menu "Proximity UUID"
            config BLE_UUID_1
                hex "UUID 1"
                default 0x01
            config BLE_UUID_2
                hex "UUID 2"
                default 0x12
            config BLE_UUID_3
                hex "UUID 3"
                default 0x23
            config BLE_UUID_4
                hex "UUID 4"
                default 0x34
        endmenu

        menu "BLE devices"

            config BLE_DEVICE_1
                bool "Set BLE Device 1"
                default y
            config BLE_DEVICE_1_MAJ
                hex "Major value of BLE device 1" if BLE_DEVICE_1
                default 0x07
            config BLE_DEVICE_1_MIN
                hex "Minor value of BLE device 1" if BLE_DEVICE_1
                default 0x01
            config BLE_DEVICE_1_NAME
                string "Name of BLE device 1" if BLE_DEVICE_1
                default "beac1"

            config BLE_DEVICE_2
                bool "Set BLE Device 2"
                default y
            config BLE_DEVICE_2_MAJ
                hex "Major value of BLE device 2" if BLE_DEVICE_2
                default 0x07
            config BLE_DEVICE_2_MIN
                hex "Minor value of BLE device 2" if BLE_DEVICE_2
                default 0x02
            config BLE_DEVICE_2_NAME
                string "Name of BLE device 2" if BLE_DEVICE_2
                default "beac2"

            config BLE_DEVICE_3
                bool "Set BLE device 3"
                default y
            config BLE_DEVICE_3_MAJ
                hex "Major value of BLE device 3" if BLE_DEVICE_3
                default 0x07
            config BLE_DEVICE_3_MIN
                hex "Minor value of BLE device 3" if BLE_DEVICE_3
                default 0x03
            config BLE_DEVICE_3_NAME
                string "Name of BLE device 3" if BLE_DEVICE_3
                default "beac3"

            config BLE_DEVICE_4
                bool "Set BLE Device 4"
                default y
            config BLE_DEVICE_4_MAJ
                hex "Major value of BLE device 4" if BLE_DEVICE_4
                default 0x07
            config BLE_DEVICE_4_MIN
                hex "Minor value of BLE device 4" if BLE_DEVICE_4
                default 0x04
            config BLE_DEVICE_4_NAME
                string "Name of BLE device 4" if BLE_DEVICE_4
                default "beac4"

            config BLE_DEVICE_5
                bool "Set BLE Device 5"
                default y
            config BLE_DEVICE_5_MAJ
                hex "Major value of BLE device 5" if BLE_DEVICE_5
                default 0x07
            config BLE_DEVICE_5_MIN
                hex "Minor value of BLE device 5" if BLE_DEVICE_5
                default 0x05
            config BLE_DEVICE_5_NAME
                string "Name of BLE device 5" if BLE_DEVICE_5
                default "beac5"

            config BLE_DEVICE_6
                bool "Set BLE Device 6"
                default y
            config BLE_DEVICE_6_MAJ
                hex "Major value of BLE device 6" if BLE_DEVICE_6
                default 0x07
            config BLE_DEVICE_6_MIN
                hex "Minor value of BLE device 6" if BLE_DEVICE_6
                default 0x06
            config BLE_DEVICE_6_NAME
                string "Name of BLE device 6" if BLE_DEVICE_6
                default "beac6"

            config BLE_DEVICE_7
                bool "Set BLE Device 7"
                default y
            config BLE_DEVICE_7_MAJ
                hex "Major value of BLE device 7" if BLE_DEVICE_7
                default 0x07
            config BLE_DEVICE_7_MIN
                hex "Minor value of BLE device 7" if BLE_DEVICE_7
                default 0x07
            config BLE_DEVICE_7_NAME
                string "Name of BLE device 7" if BLE_DEVICE_7
                default "beac7"

            config BLE_DEVICE_8
                bool "Set BLE Device 8"
                default y
            config BLE_DEVICE_8_MAJ
                hex "Major value of BLE device 8" if BLE_DEVICE_8
                default 0x07
            config BLE_DEVICE_8_MIN
                hex "Minor value of BLE device 8" if BLE_DEVICE_8
                default 0x08
            config BLE_DEVICE_8_NAME
                string "Name of BLE device 8" if BLE_DEVICE_8
                default "beac8"

            config BLE_DEVICE_9
                bool "Set BLE Device 9"
                default y
            config BLE_DEVICE_9_MAJ
                hex "Major value of BLE device 9" if BLE_DEVICE_9
                default 0x07
            config BLE_DEVICE_9_MIN
                hex "Minor value of BLE device 9" if BLE_DEVICE_9
                default 0x09
            config BLE_DEVICE_9_NAME
                string "Name of BLE device 9" if BLE_DEVICE_9
                default "beac9"

            config BLE_DEVICE_10
                bool "Set BLE Device 10"
                default y
            config BLE_DEVICE_10_MAJ
                hex "Major value of BLE device 10" if BLE_DEVICE_10
                default 0x07
            config BLE_DEVICE_10_MIN
                hex "Minor value of BLE device 10" if BLE_DEVICE_10
                default 0x0A
            config BLE_DEVICE_10_NAME
                string "Name of BLE device 10" if BLE_DEVICE_10
                default "beac10"

        endmenu

        config BLE_DEVICE_COUNT_CONFIGURED
            int "Number of BLE devices configured"
            range 0 10
            default 10 if BLE_DEVICE_10
            default 9 if BLE_DEVICE_9
            default 8 if BLE_DEVICE_8
            default 7 if BLE_DEVICE_7
            default 6 if BLE_DEVICE_6
            default 5 if BLE_DEVICE_5
            default 4 if BLE_DEVICE_4
            default 3 if BLE_DEVICE_3
            default 2 if BLE_DEVICE_2
            default 1 if BLE_DEVICE_1
            default 0

        config BLE_DEVICE_COUNT_USE
            int "Number of BLE devices to use"
            help
                Number of BLE devices to use, must by >= number of BLE devices configured
            range 0 10

        config ACTIVE_BLE_DEVICE_MASK
            int "BLE device active mask"
            help
                Mask which beacons are initially active. This is only used once if the NVS is not yet initialized with the params."
            range 0 1023
            default 1023

        config ACTIVE_BLE_DEVICE_PERSISTANCE
            int "Store active beacon mask (after changes) to NVS"
            range 0 1
            default 0

        config PROXIMITY_RSSI_THRESHOLD
            int "Proximity RSSI Threshold"
            range -80 0
            default -27
            help
                Lower limit for RSSI to initiate an beacon announcement by getting close to the proxy.

        menu "OFfline Buffer"

            config OFFLINE_BUFFER_SIZE
            int "Max. number of offline buffer entries provided by beacon"
            range 0 5000
            default 1250

        endmenu

    endmenu

    menu "Button"

        config IO_GLITCH_FILTER_TIME_MS
            int "IO glitch filter timer ms (10~100)"
            range 10 100
            default 50

        config LONG_PRESS_TIME
            int "ms to press for a long button press"
            range 0 10000
            default 2000
    endmenu

    menu "OTA"

        config OTA_FIRMWARE_UPG_URL
            string "Firmware Upgrade URL"
            default "https://192.168.2.130:8070/blemqttproxy.bin"
            help
                URL of server which hosts the firmware image.

        config OTA_SKIP_COMMON_NAME_CHECK
            bool "Skip server certificate CN fieldcheck"
            default n
            help
                This allows you to skip the validation of OTA server certificate CN field.

        config OTA_SKIP_VERSION_CHECK
            bool "Skip firmware version check"
            default n
            help
                This allows you to skip the firmware version check.

        config OTA_RECV_TIMEOUT
            int "OTA Receive Timeout"
            default 5000
            help
                Maximum time for reception
    endmenu

    menu "Test functions"

        config DISPLAY_TIME_TEST
            bool "Add extra display screen with tests (currently not in use!)"
            default n
    endmenu

endmenu
```
